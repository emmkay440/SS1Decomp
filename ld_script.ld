OUTPUT_ARCH(arm)
ENTRY(_start)

INCLUDE ld_symbols.ld

SECTIONS {
    . = 0x08000000;

    .text : {
        asm/crt0.o(.text);
        asm/code.o(.text);
        src/agb_main.o(.text);
        src/input.o(.text);
        src/display.o(.text);
        src/display_misc.o(.text);
        src/interrupts.o(.text);
        asm/hblank.o(.text);
        src/intr_handlers.o(.text);
        src/copy_queue.o(.text);
        src/heap.o(.text);
        asm/heap_free.o(.text);
        src/heap_top.o(.text);
        src/lib/multi_sio.o(.text);
        src/save.o(.text);
        src/game_main.o(.text);
        src/link_thread.o(.text);
        asm/code_08001B78.o(.text);
        src/link.o(.text);
        src/logos.o(.text);
        src/unk_080022BC.o(.text);
        src/title_menu.o(.text);
        src/title_menu_start.o(.text);
        src/unk_0800277C.o(.text);
        asm/code_08002790.o(.text);
        src/unk_08002B58.o(.text);
        asm/data_record.o(.text);
        src/data_count.o(.text);
        src/oam_draw.o(.text);
        src/oam_frame_tiles.o(.text);
        src/oam_draw_tiles.o(.text);
        src/oam_draw_copy.o(.text);
        src/oam_draw_affine.o(.text);
        src/oam_draw_affine_mode.o(.text);
        src/oam_draw_affine2.o(.text);
        src/oam_draw_mode.o(.text);
        src/unk_080041D4.o(.text);
        src/anim_step.o(.text);
        src/draw_sorted.o(.text);
        src/draw_list.o(.text);
        src/map_init.o(.text);
        src/map_bg_setup.o(.text);
        asm/code_080046E4.o(.text);
        asm/map_layer2_bg.o(.text);
        src/map_edge.o(.text);
        asm/code_08004AE4.o(.text);
        src/map_layer1_init.o(.text);
        src/map_layer2_init.o(.text);
        asm/map_tile_anim.o(.text);
        src/map_load.o(.text);
        src/map_layer1_thread.o(.text);
        src/map_layer2_thread.o(.text);
        src/camera_follow.o(.text);
        asm/code_08005A2C.o(.text);
        src/map.o(.text);
        asm/map_6008.o(.text);
        asm/map_attr.o(.text);
        src/map_bg.o(.text);
        src/unk_08006114.o(.text);
        src/field_session.o(.text);
        asm/code_08006414.o(.text);
        src/game_flags.o(.text);
        asm/code_080077D0.o(.text);
        src/player_setup.o(.text);
        asm/code_0800B1B0.o(.text);
        src/player_damage.o(.text);
        asm/code_0800B4B4.o(.text);
        src/enemy_bearing.o(.text);
        src/enemy_push.o(.text);
        asm/code_0800B594.o(.text);
        src/player_step.o(.text);
        asm/code_0800B8A4.o(.text);
        src/player_skill_threads0.o(.text);
        src/player_attack_thread.o(.text);
        src/player_skill_threads.o(.text);
        src/spawn_player.o(.text);
        src/hud_start.o(.text);
        src/enemy_pool_alloc.o(.text);
        src/enemy_unload.o(.text);
        src/enemy_spawn.o(.text);
        src/enemy_start0.o(.text);
        src/enemy_spawn_thread.o(.text);
        asm/nearest_player.o(.text);
        src/direction_to.o(.text);
        src/unk_0800CB84.o(.text);
        asm/code_0800CBD8.o(.text);
        src/enemy_separate_one.o(.text);
        src/enemy_separate.o(.text);
        asm/enemy_update_msg.o(.text);
        src/enemy_hit_type.o(.text);
        src/enemy_slot.o(.text);
        src/enemy_damage.o(.text);
        src/enemy_util.o(.text);
        src/text_wrapped.o(.text);
        src/text_layer.o(.text);
        src/unk_0800EE44.o(.text);
        asm/code_0800EEA0.o(.text);
        src/fade.o(.text);
        asm/code_0800F470.o(.text);
        asm/drop_item.o(.text);
        asm/code_0800F53C.o(.text);
        src/item_flags.o(.text);
        src/inventory_add.o(.text);
        src/drop_spot.o(.text);
        src/item_price.o(.text);
        asm/can_equip.o(.text);
        src/equip_bonus.o(.text);
        asm/equip_has.o(.text);
        src/equip_bonus2.o(.text);
        asm/equip_bonus_scaled.o(.text);
        src/equip_bonus3.o(.text);
        asm/code_08012230.o(.text);
        src/item_roll.o(.text);
        src/field_items_thread.o(.text);
        asm/code_08013310.o(.text);
        src/materials.o(.text);
        src/player_stats.o(.text);
        src/field_items.o(.text);
        src/field_items2.o(.text);
        src/items.o(.text);
        src/item_records.o(.text);
        src/equipment.o(.text);
        src/item_bonus.o(.text);
        src/inventory_misc.o(.text);
        src/item_bonus2.o(.text);
        src/name_list.o(.text);
        src/start_equipment.o(.text);
        asm/player_status_tick.o(.text);
        asm/code_0801574C.o(.text);
        src/heal_near.o(.text);
        src/skill_check2.o(.text);
        src/stats.o(.text);
        src/exp_gain.o(.text);
        src/exp.o(.text);
        src/player_attack_damage.o(.text);
        src/player_calc_damage.o(.text);
        asm/code_08017664.o(.text);
        asm/enemy_melee.o(.text);
        src/effect_anim.o(.text);
        src/effect_obj.o(.text);
        src/effect_obj3.o(.text);
        src/effect_obj5.o(.text);
        src/effect_pool.o(.text);
        src/effect_number.o(.text);
        src/area_alloc.o(.text);
        src/thread_slots_free.o(.text);
        asm/code_08018940.o(.text);
        src/area_place_player.o(.text);
        src/area_enter_pos.o(.text);
        src/enemy_spawner_thread.o(.text);
        src/enemy_spawner_start.o(.text);
        asm/spawn_points.o(.text);
        src/area_list_find.o(.text);
        asm/code_08019C40.o(.text);
        src/area_exit_thread.o(.text);
        asm/area_change_thread.o(.text);
        src/menu_open.o(.text);
        asm/code_0801B210.o(.text);
        src/message_wait.o(.text);
        src/intro_messages.o(.text);
        src/area_markers.o(.text);
        asm/code_0801CFB0.o(.text);
        src/area_traps.o(.text);
        asm/area_switched_traps.o(.text);
        src/area_timed_traps.o(.text);
        src/area_switches.o(.text);
        asm/area_pillars.o(.text);
        asm/code_0801E014.o(.text);
        src/npc_gift_f160.o(.text);
        asm/npc_walker.o(.text);
        src/npc_gift_f9c8.o(.text);
        src/npc_gift.o(.text);
        src/npc_gift_01b0.o(.text);
        src/npc_gift_0604.o(.text);
        asm/npc_gift_0adc.o(.text);
        src/thread_starters.o(.text);
        src/area_start_pos.o(.text);
        src/unk_0802173C.o(.text);
        src/window_gfx.o(.text);
        src/window_open.o(.text);
        src/window_thread.o(.text);
        src/window_kill.o(.text);
        src/message_window_start.o(.text);
        asm/code_08022010.o(.text);
        src/window_checks.o(.text);
        src/hud_sprites.o(.text);
        src/text_number.o(.text);
        asm/item_icon.o(.text);
        asm/code_08023330.o(.text);
        asm/hud_weapon_wheel.o(.text);
        asm/code_08023E74.o(.text);
        asm/number_above.o(.text);
        src/player_rise_effect.o(.text);
        src/link_lost.o(.text);
        src/link_save_reset.o(.text);
        src/quit_to_title.o(.text);
        asm/code_0802501C.o(.text);
        src/warp_spot_thread.o(.text);
        asm/code_08025BFC.o(.text);
        src/area_title.o(.text);
        src/sprite_obj.o(.text);
        src/thread_slots.o(.text);
        asm/code_08026D98.o(.text);
        src/char_menu_threads.o(.text);
        src/centered_text.o(.text);
        src/player_threads.o(.text);
        src/queue_init.o(.text);
        src/queue_push3.o(.text);
        src/queue_push2.o(.text);
        asm/code_08027828.o(.text);
        src/queue_push4.o(.text);
        src/queue_to_front.o(.text);
        src/queue_thread.o(.text);
        asm/code_08027E40.o(.text);
        asm/link_sync.o(.text);
        src/queue_push.o(.text);
        src/unk_080292D0.o(.text);
        src/spell_area_hit.o(.text);
        src/spell_damage.o(.text);
        src/enemy_hit.o(.text);
        asm/spell_effect_thread.o(.text);
        src/spell_effect_start.o(.text);
        src/effect_obj4.o(.text);
        src/unk_08029BB4.o(.text);
        asm/code_08029C44.o(.text);
        src/spell_status_near.o(.text);
        asm/spell_sleep.o(.text);
        src/skill_thread_start.o(.text);
        asm/target_in_front.o(.text);
        asm/code_0802C25C.o(.text);
        src/item_use_thread.o(.text);
        src/item_use_effect.o(.text);
        src/item_use_thread3.o(.text);
        src/item_use_effect2.o(.text);
        asm/code_0802CA30.o(.text);
        src/unk_0802CE40.o(.text);
        asm/code_0802CED4.o(.text);
        src/unk_0802D49C.o(.text);
        asm/code_0802D53C.o(.text);
        src/unk_0802D98C.o(.text);
        src/spell_damage_player.o(.text);
        asm/code_0802DC18.o(.text);
        src/effect_pools.o(.text);
        src/save_game.o(.text);
        asm/save_slot_info.o(.text);
        asm/save_load_or_new.o(.text);
        src/save_check.o(.text);
        src/save_options.o(.text);
        asm/code_0802F618.o(.text);
        src/unk_08031250.o(.text);
        asm/code_08031334.o(.text);
        src/effect_palette_anim.o(.text);
        src/thread_pools.o(.text);
        asm/code_08033FB0.o(.text);
        asm/enemy_bolt.o(.text);
        asm/enemy_wave.o(.text);
        src/thread_pools2.o(.text);
        asm/code_0803578C.o(.text);
        src/enemy_start.o(.text);
        asm/code_08036DC0.o(.text);
        src/enemy_projectile.o(.text);
        asm/code_08037D98.o(.text);
        asm/enemy_projectile2.o(.text);
        src/enemy_threads.o(.text);
        asm/code_08038AF8.o(.text);
        asm/enemy_shot.o(.text);
        asm/code_08039EC8.o(.text);
        src/thread_pool18.o(.text);
        asm/code_0803A448.o(.text);
        src/unk_0803BE28.o(.text);
        asm/code_0803BEFC.o(.text);
        src/enemy_threads2_free.o(.text);
        src/enemy_effect_line.o(.text);
        asm/code_0803EDD8.o(.text);
        src/enemy_threads2.o(.text);
        src/sound.o(.text);
        src/menu_screen.o(.text);
        src/menu_setup.o(.text);
        src/menu_alloc.o(.text);
        src/menu_apply.o(.text);
        src/menu_stats_changed.o(.text);
        src/menu_skill_tick.o(.text);
        src/menu_stat_sync.o(.text);
        asm/menu_gold_count2.o(.text);
        src/menu_gold_count.o(.text);
        src/menu_pick_up.o(.text);
        src/menu_drop_item.o(.text);
        asm/menu_slot_item.o(.text);
        src/menu_item_price.o(.text);
        asm/menu_quick_slots.o(.text);
        src/menu_can_put.o(.text);
        src/menu_state.o(.text);
        src/menu_items.o(.text);
        src/menu_stats.o(.text);
        src/menu_stats2.o(.text);
        src/menu_inventory_scan.o(.text);
        asm/code_08041538.o(.text);
        src/menu_draw.o(.text);
        src/menu_cursor_draw.o(.text);
        src/menu_page_arrows.o(.text);
        src/menu_slot_value.o(.text);
        asm/code_0804288C.o(.text);
        src/menu_stats_diff.o(.text);
        asm/code_08043378.o(.text);
        src/menu_misc.o(.text);
        src/unk_08043DB8.o(.text);
        asm/code_08043EDC.o(.text);
        src/menu_price_buy.o(.text);
        src/menu_price.o(.text);
        src/menu_cursor_mode.o(.text);
        src/menu_cursor_pos.o(.text);
        asm/code_080453DC.o(.text);
        src/menu_cursor_move.o(.text);
        src/unk_030005B8.o(.text);
        src/unk_030005B8_2.o(.text);
        src/unk_08046128.o(.text);
        src/save_select_start.o(.text);
        src/save_select_dpad.o(.text);
        asm/code_080466A8.o(.text);
        src/save_select_setup.o(.text);
        src/save_select_bg.o(.text);
        src/save_select_frame.o(.text);
        src/save_select_chars.o(.text);
        src/save_select_cursor.o(.text);
        asm/save_select_slots.o(.text);
        src/save_select_stats.o(.text);
        src/name_entry_cursor.o(.text);
        src/name_entry_move.o(.text);
        asm/name_entry_char.o(.text);
        src/save_select_misc.o(.text);
        src/save_select_thread.o(.text);
        src/save_select_dispatch.o(.text);
        src/save_select_mode0_setup.o(.text);
        src/save_select_mode0_seq.o(.text);
        src/save_select_mode0_add.o(.text);
        src/save_select_mode0_runners.o(.text);
        src/save_select_mode0.o(.text);
        src/save_select_mode1_setup.o(.text);
        src/save_select_mode1_seq.o(.text);
        src/save_select_mode1_add.o(.text);
        src/save_select_mode1_drops.o(.text);
        src/save_select_mode1.o(.text);
        src/save_select_mode2_setup.o(.text);
        src/save_select_mode2_seq.o(.text);
        asm/code_08049A24.o(.text);
        src/save_select_mode2_orbit.o(.text);
        src/save_select_mode2.o(.text);
        src/save_select_mode3_setup.o(.text);
        src/save_select_mode3_scroll.o(.text);
        asm/code_0804A074.o(.text);
        src/save_select_mode3_add.o(.text);
        src/save_select_mode3.o(.text);
        src/save_select_mode4_setup.o(.text);
        asm/code_0804A5FC.o(.text);
        src/save_select_mode4_add.o(.text);
        src/save_select_mode4.o(.text);
        src/save_select_mode5_setup.o(.text);
        src/save_select_mode5_scroll.o(.text);
        src/save_select_drop.o(.text);
        src/save_select_mode5_add.o(.text);
        src/save_select_mode5.o(.text);
        src/save_select_mode6_setup.o(.text);
        src/save_select_mode6_seq.o(.text);
        src/save_select_mode6.o(.text);
        src/save_select_mode7_setup.o(.text);
        src/save_select_mode7_scroll.o(.text);
        src/save_select_mode7_seq.o(.text);
        src/save_select_mode7.o(.text);
        src/save_select_mode8_setup.o(.text);
        src/save_select_mode8_scroll.o(.text);
        src/save_select_mode8_seq.o(.text);
        src/save_select_mode8.o(.text);
        src/unk_0804C9C4.o(.text);
        src/picture_setup.o(.text);
        asm/code_0804CF64.o(.text);
        src/unk_0804E1E4.o(.text);
        src/palette_fade_clamp.o(.text);
        src/palette_fade_bright.o(.text);
        src/palette_fade_add.o(.text);
        src/palette_fade_sub.o(.text);
        src/palette_fade_step.o(.text);
        asm/code_0804E8BC.o(.text);
        src/palette_fade_to.o(.text);
        src/palette_fill.o(.text);
        src/palette_save.o(.text);
        src/picture_screen.o(.text);
        src/sprite_drift.o(.text);
        asm/code_0804F31C.o(.text);
        src/unk_0804F99C.o(.text);
        asm/code_0804FAA8.o(.text);
        asm/lib/m4a_1.o(.text);
        src/lib/m4a.o(.text);
        asm/lib/libagbsyscall.o(.text);
        asm/lib/agb_flash.o(.text);
        asm/lib/libgcc.o(.text);
        asm/lib/libc.o(.text);
    } =0

    .rodata : {
        data/data.o(.rodata);
    } =0

    /DISCARD/ : { *(*) }
}
